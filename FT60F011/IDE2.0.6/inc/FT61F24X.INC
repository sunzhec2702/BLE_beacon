          LIST

;==========================================================================
;  MPASM FMD61F021 processor include
; 
;  (c) Copyright 1999-2016 Fremont Micro Devices Ltd., All rights reserved
;==========================================================================

        NOLIST

;==========================================================================
;==========================================================================
;
;       Verify Processor
;
;==========================================================================
;==========================================================================
;
;       Register Definitions
;
;==========================================================================
W                EQU  H'0000' 
F                EQU  H'0001'
R                EQU  H'0001'				
;----- Register Files -----------------------------------------------------
;-----Bank0------------------
INDF             EQU  H'0000'
TMR0             EQU  H'0001'
PCL              EQU  H'0002'
STATUS           EQU  H'0003'
FSR              EQU  H'0004'
PORTA            EQU  H'0005'  
PORTB            EQU  H'0006'
PORTC			 			 EQU  H'0007'
PCLATH           EQU  H'000A'
INTCON           EQU  H'000B'
PIR1             EQU  H'000C'
PIR2             EQU  H'000D'
TMR1L            EQU  H'000E'
TMR1H            EQU  H'000F'
T1CON            EQU  H'0010'
TMR2             EQU  H'0011'
T2CON            EQU  H'0012'
CCPR1L           EQU  H'0013'
CCPR1H           EQU  H'0014'
CCP1CON          EQU  H'0015'
PWM1CON          EQU  H'0016'
ECCPAS           EQU  H'0017'
WDTCON           EQU  H'0018'
CMCON0           EQU  H'0019'
CMCON1           EQU  H'001A'
MSCKCON          EQU  H'001B'
SOSCPRL          EQU  H'001C'
SOSCPRH          EQU  H'001D'
ADRESH           EQU  H'001E'
ADCON0           EQU  H'001F'
;-----Bank1------------------
OPTION_REG       EQU  H'0081'
OPTION      	   EQU  H'0081'
TRISA            EQU  H'0085'   
TRISB            EQU  H'0086'
TRISC            EQU  H'0087'
WPUC             EQU  H'0088'
WPD              EQU  H'0089'
PIE1             EQU  H'008C'
PIE2             EQU  H'008D'
PCON             EQU  H'008E'
OSCCON           EQU  H'008F'
PWM1AUX          EQU  H'0090'
ANSEL            EQU  H'0091'
PR2              EQU  H'0092'
DACOE            EQU  H'0093'
DACCON0          EQU  H'0094'
WPUA             EQU  H'0095'
IOF              EQU  H'0096'
IOFA             EQU  H'0096'
D2ICON           EQU  H'0097'
VRCON            EQU  H'0099'
EEDAT            EQU  H'009A'
EEDATA           EQU  H'009A'
EEADDR           EQU  H'009B'
EEADR            EQU  H'009B'
EECON1           EQU  H'009C'
EECON2           EQU  H'009D'
ADRESL           EQU  H'009E'
ADCON1           EQU  H'009F'
;-----Bank2------------------    
CMCON2 		       EQU  H'0101'
EPWMCR1          EQU  H'0105' 
WPUB			 		   EQU  H'0106' 
CMCON3           EQU  H'0107'
VCON1            EQU  H'0108'
VCON2            EQU  H'0109'
TMR3L            EQU  H'010C'
TMR3H            EQU  H'010D'
PR3L             EQU  H'010E'
PWM3CR0          EQU  H'010F'
PWM3CR1          EQU  H'0110'
T3CKDIV          EQU  H'0111'
TMR4L            EQU  H'0112'
TMR4H            EQU  H'0113'
PR4L	           EQU  H'0114'
PWM4CR0          EQU  H'0115'
PWM4CR1          EQU  H'0116'
T4CKDIV          EQU  H'0117'
TMR5L            EQU  H'0118'
TMR5H            EQU  H'0119'
PR5L	           EQU  H'011A'
PWM5CR0          EQU  H'011B'
PWM5CR1          EQU  H'011C'
T5CKDIV          EQU  H'011D'
EPWMCR0          EQU  H'011E'
CMCON4           EQU  H'011F'
;-----Bank3------------------
DEBCR 		       EQU  H'0181'
PPGCON1          EQU  H'0188'
PPRH			       EQU  H'0189'
PPRA             EQU  H'018C'
PPRB             EQU  H'018D'
PWLTPRL          EQU  H'018E'
PPGCON2          EQU  H'018F'
CMP0CR           EQU  H'0190'
CMP1CR           EQU  H'0191'
CMP2CR           EQU  H'0192'
CMP3CR           EQU  H'0193'
OP0CR0           EQU  H'0194'
TMR6L            EQU  H'0198'
TMR6H            EQU  H'0199'
PR6L	           EQU  H'019A'
PWM6CR0          EQU  H'019B'
PWM6CR1          EQU  H'019C'
T6CKDIV          EQU  H'019D'
PPGCON3          EQU  H'019E'
;-----Bank0------------------
;----- STATUS Bits -----------------------------------------------------
C                EQU  H'0000'
DC               EQU  H'0001'
HC				       EQU  H'0001'
Z                EQU  H'0002'
PF               EQU  H'0003'
NOT_PD           EQU  H'0003'
TF               EQU  H'0004'
NOT_TO           EQU  H'0004'
PAGE0			       EQU  H'0005'
RP0              EQU  H'0005'
PAGE1			       EQU  H'0006'
RP1				       EQU  H'0006'
FSR_B8			     EQU  H'0007'
;----- PORTA Bits -----------------------------------------------------
RA0              EQU  H'0000'
PA0              EQU  H'0000'
RA1              EQU  H'0001'
PA1              EQU  H'0001'
RA2              EQU  H'0002'
PA2              EQU  H'0002'
RA3              EQU  H'0003'
PA3              EQU  H'0003'
RA4              EQU  H'0004'
PA4              EQU  H'0004'
RA5              EQU  H'0005'
PA5              EQU  H'0005'
RA6              EQU  H'0006'
PA6              EQU  H'0006'
RA7              EQU  H'0007'
PA7              EQU  H'0007'
;----- PORTB Bits -----------------------------------------------------
RB0              EQU  H'0000'
PB0              EQU  H'0000'
RB1              EQU  H'0001'
PB1              EQU  H'0001'
RB2              EQU  H'0002'
PB2              EQU  H'0002'
RB3              EQU  H'0003'
PB3              EQU  H'0003'
;----- PORTC Bits -----------------------------------------------------
RC0              EQU  H'0000'
PC0              EQU  H'0000'
RC1              EQU  H'0001'
PC1              EQU  H'0001'
RC2              EQU  H'0002'
PC2              EQU  H'0002'
RC3              EQU  H'0003'
PC3              EQU  H'0003'
RC4              EQU  H'0004'
PC4              EQU  H'0004'
RC5              EQU  H'0005'
PC5              EQU  H'0005'
;----- INTCON Bits -----------------------------------------------------
RAIF             EQU  H'0000'
PAIF             EQU  H'0000'
INTF             EQU  H'0001'
T0IF             EQU  H'0002'
TMR0IF           EQU  H'0002'
RAIE             EQU  H'0003'
PAIE             EQU  H'0003'
INTE             EQU  H'0004'
T0IE             EQU  H'0005'
TMR0IE           EQU  H'0005'
PEIE             EQU  H'0006'
GIE              EQU  H'0007'
;----- PIR1 Bits -----------------------------------------------------
TMR1IF           EQU  H'0000'
T1IF             EQU  H'0000'
TMR2IF           EQU  H'0001'
T2IF             EQU  H'0001'
OSFIF			       EQU  H'0002'
C4IF			       EQU  H'0003'
C5IF			       EQU  H'0004'
CKMEAIF          EQU  H'0006'
EEIF             EQU  H'0007'
;----- PIR2 Bits -----------------------------------------------------
CCP1IF           EQU  H'0000'
ADIF             EQU  H'0001'
C0IF			       EQU  H'0002'
C1IF			       EQU  H'0003'
C2IF			       EQU  H'0004'
C3IF			       EQU  H'0005'
;----- T1CON Bits -----------------------------------------------------
TMR1ON           EQU  H'0000'
TMR1CS           EQU  H'0001'
T1SYNC           EQU  H'0002'
T1OSCEN          EQU  H'0003'
T1CKPS0          EQU  H'0004'
T1CKPS1          EQU  H'0005'
TMR1GE           EQU  H'0006'
T1GINV           EQU  H'0007'
;----- T2CON Bits -----------------------------------------------------
T2CKPS0          EQU  H'0000'
T2CKPS1          EQU  H'0001'
TMR2ON           EQU  H'0002'
TOUTPS0          EQU  H'0003'
TOUTPS1          EQU  H'0004'
TOUTPS2          EQU  H'0005'
TOUTPS3          EQU  H'0006'
NRPM	           EQU  H'0007'
;----- CCP1CON Bits -----------------------------------------------------
CCP1M0           EQU  H'0000'
CCP1M1           EQU  H'0001'
CCP1M2           EQU  H'0002'
CCP1M3           EQU  H'0003'
DC1B0            EQU  H'0004'
DC1B1            EQU  H'0005'
P1M0             EQU  H'0006'
P1M1             EQU  H'0007'
;----- PWM1CON Bits -----------------------------------------------------
PDC0             EQU  H'0000'
PDC1             EQU  H'0001'
PDC2             EQU  H'0002'
PDC3             EQU  H'0003'
PDC4             EQU  H'0004'
PDC5             EQU  H'0005'
PDC6             EQU  H'0006'
PRSEN            EQU  H'0007'
;----- ECCPAS Bits -----------------------------------------------------
PSSBD0           EQU  H'0000'
PSSBD1           EQU  H'0001'
PSSAC0           EQU  H'0002'
PSSAC1           EQU  H'0003'
ECCPAS0          EQU  H'0004'
ECCPAS1          EQU  H'0005'
ECCPAS2          EQU  H'0006'
ECCPASE          EQU  H'0007'
;----- WDTCON Bits -----------------------------------------------------
SWDTEN           EQU  H'0000'
WDTPS0           EQU  H'0001'
WDTPS1           EQU  H'0002'
WDTPS2           EQU  H'0003'
WDTPS3           EQU  H'0004'
;----- CMCON0 Bits -----------------------------------------------------
CM0              EQU  H'0000'
CM1              EQU  H'0001'
CM2              EQU  H'0002'
CIS              EQU  H'0003'
C4INV            EQU  H'0004'
C5INV            EQU  H'0005'
C4OUT			       EQU  H'0006'
C5OUT			       EQU  H'0007'
;----- CMCON1 Bits -----------------------------------------------------
C5SYNC           EQU  H'0000'
T1GSS            EQU  H'0001'
HYSEN0           EQU  H'0004'
HYSEN1           EQU  H'0005'
HYSEN2           EQU  H'0006'
HYSEN3           EQU  H'0007'
;----- MSCKCON Bits -----------------------------------------------------
CKCNTI           EQU  H'0001'
CKMAVG           EQU  H'0002'
SLVREN			     EQU  H'0004'
T2CKSRC			     EQU  H'0005'
;----- ADCON0 Bits -----------------------------------------------------
ADON             EQU  H'0000'
GO		           EQU  H'0001'
GO_DONE          EQU  H'0001'
CHS0             EQU  H'0002'
CHS1             EQU  H'0003'
CHS2    		     EQU  H'0004'
VCFG0			       EQU  H'0005'
VCFG1			       EQU  H'0006'
ADFM			       EQU  H'0007'
;-----Bank1------------------
;----- OPTION_REG Bits -----------------------------------------------------
PS0              EQU  H'0000'
PS1              EQU  H'0001'
PS2              EQU  H'0002'
PSA              EQU  H'0003'
T0SE             EQU  H'0004'
T0CS             EQU  H'0005'
INTEDG           EQU  H'0006'
PAPU			       EQU  H'0007'
RAPU			       EQU  H'0007'
NOT_PAPU         EQU  H'0007'
NOT_RAPU         EQU  H'0007'
;----- TRISA Bits -----------------------------------------------------
TRISA0           EQU  H'0000'
TRISA1           EQU  H'0001'
TRISA2           EQU  H'0002'
TRISA3           EQU  H'0003'
TRISA4           EQU  H'0004'
TRISA5           EQU  H'0005'
TRISA6           EQU  H'0006'
TRISA7           EQU  H'0007'
;----- TRISB Bits -----------------------------------------------------
TRISB0           EQU  H'0000'
TRISB1           EQU  H'0001'
TRISB2           EQU  H'0002'
TRISB3           EQU  H'0003'
;----- TRISC Bits -----------------------------------------------------
TRISC0           EQU  H'0000'
TRISC1           EQU  H'0001'
TRISC2           EQU  H'0002'
TRISC3           EQU  H'0003'
TRISC4           EQU  H'0004'
TRISC5           EQU  H'0005'
;----- WPUC Bits -----------------------------------------------------
WPUC0            EQU  H'0000'
WPUC1            EQU  H'0001'
WPUC2            EQU  H'0002'
WPUC3            EQU  H'0003'
WPUC4            EQU  H'0004'
WPUC5            EQU  H'0005'
;----- WPD Bits -----------------------------------------------------
WPDC3            EQU  H'0001'
WPDC2            EQU  H'0002'
WPDC1            EQU  H'0003'
WPDA4            EQU  H'0004'
;----- PIE1 Bits -----------------------------------------------------
T1IE             EQU  H'0000'
TMR1IE           EQU  H'0000'
T2IE             EQU  H'0001'
TMR2IE           EQU  H'0001'
OSFIE            EQU  H'0002'
C4IE             EQU  H'0003'
C5IE             EQU  H'0004'
CKMEAIE          EQU  H'0006'
EEIE             EQU  H'0007'
;----- PIE2 Bits -----------------------------------------------------
CCP1IE           EQU  H'0000'
ADIE             EQU  H'0001'
C0IE             EQU  H'0002'
C1IE             EQU  H'0003'
C2IE             EQU  H'0004'
C3IE             EQU  H'0005'
;----- PCON Bits -----------------------------------------------------
BOR              EQU  H'0000'
NOT_BOR          EQU  H'0000'
POR              EQU  H'0001'
NOT_POR          EQU  H'0001'
LVDW             EQU  H'0002'
LVDEN            EQU  H'0003'
LVDL0            EQU  H'0004'
LVDL1            EQU  H'0005'
LVDL2            EQU  H'0006'
SYSON	           EQU  H'0007'
;----- OSCCON Bits -----------------------------------------------------
SCS				       EQU  H'0000'
LTS              EQU  H'0001'
LFIOFR			     EQU  H'0001'
HTS              EQU  H'0002'
HFIOFR			     EQU  H'0002'
OSTS			       EQU  H'0003'
IRCF0            EQU  H'0004'
IRCF1            EQU  H'0005'
IRCF2            EQU  H'0006'
LFMOD			       EQU  H'0007'
LFOMOD			     EQU  H'0007'
;----- PWM1AUX Bits -----------------------------------------------------
P1AOE			       EQU  H'0000'
P1BOE            EQU  H'0001'
P1COE            EQU  H'0002'
P1DOE			       EQU  H'0003'
P1EOE            EQU  H'0004'
P1FOE            EQU  H'0005'
P1OS             EQU  H'0006'
AUX1EN			 EQU  H'0007'
;----- ANSEL Bits -----------------------------------------------------
ANSEL0			     EQU  H'0000'
ANSEL1           EQU  H'0001'
ANSEL2           EQU  H'0002'
ANSEL3			     EQU  H'0003'
ANSEL4           EQU  H'0004'
ANSEL5           EQU  H'0005'
ANSEL6           EQU  H'0006'
ANSEL7			     EQU  H'0007'
;----- DACOE Bits -----------------------------------------------------
DAC1OE0			     EQU  H'0000'
DAC1OE1          EQU  H'0001'
DAC1OE2          EQU  H'0002'
DAC2OE0			     EQU  H'0004'
DAC2OE1          EQU  H'0005'
DAC2OE2          EQU  H'0006'
;----- DACCON0 Bits -----------------------------------------------------
DASH			       EQU  H'0000'
DAPPD            EQU  H'0001'
DANPD            EQU  H'0002'
DBSH			       EQU  H'0004
;----- WPUA Bits -----------------------------------------------------
WPUA0            EQU  H'0000'
WPUA1            EQU  H'0001'
WPUA2            EQU  H'0002'
WPUA3            EQU  H'0003'
WPUA5            EQU  H'0005'
WPUA4            EQU  H'0004'
WPUA6            EQU  H'0006'
WPUA7            EQU  H'0007'
WPU0             EQU  H'0000'
WPU1             EQU  H'0001'
WPU2             EQU  H'0002'
WPU3             EQU  H'0003'
WPU4             EQU  H'0004'
WPU5             EQU  H'0005'
WPU6             EQU  H'0006'
WPU7             EQU  H'0007'
;----- IOCA Bits -----------------------------------------------------
IOFA0            EQU  H'0000'
IOFA1            EQU  H'0001'
IOFA2            EQU  H'0002'
IOFA3            EQU  H'0003'
IOFA4            EQU  H'0004'
IOFA5            EQU  H'0005'
IOFA6            EQU  H'0006'
IOFA7            EQU  H'0007'
;----- D2ICON Bits -----------------------------------------------------
D2IVAL0          EQU  H'0000'
D2IVAL1          EQU  H'0001'
D2IVAL2          EQU  H'0002'
D2IVAL3          EQU  H'0003'
D2IVAL4          EQU  H'0004'
D2IVAL5          EQU  H'0005'
D2ISRC           EQU  H'0006'
D2IEN            EQU  H'0007'
;----- VRCON Bits -----------------------------------------------------
VR0		           EQU  H'0000'
VR1              EQU  H'0001'
VR2              EQU  H'0002'
VR3              EQU  H'0003'
VRR              EQU  H'0005'
VREN             EQU  H'0007'
;----- EECON1 Bits -----------------------------------------------------
RD               EQU  H'0000'
WREN1			       EQU  H'0002'
WRERR            EQU  H'0003'
WREN2			       EQU  H'0004'
WREN3			       EQU  H'0005'
;----- EECON2 Bits -----------------------------------------------------
WR               EQU  H'0000'
;----- ADCON1 Bits -----------------------------------------------------
AN0SEL           EQU  H'0000'
ADCS0            EQU  H'0004'
ADCS1            EQU  H'0005'
ADCS2            EQU  H'0006'
DIVS             EQU  H'0007'
;-----Bank2------------------
;----- CMCON2 Bits -----------------------------------------------------
VR1C0	           EQU  H'0000'
VR1C1            EQU  H'0001'
VR1C2            EQU  H'0002'
VR2C0            EQU  H'0003'
VR2C1            EQU  H'0004'
VR2C2            EQU  H'0005'
C0POL            EQU  H'0006'
C1POL            EQU  H'0007'
;----- EPWMCR1 Bits -----------------------------------------------------
PWMFCKS0         EQU  H'0000'
PWMFCKS1         EQU  H'0001'
PWMFCKS2         EQU  H'0002'
PWMFCKS3         EQU  H'0003'
;----- WPUB Bits -----------------------------------------------------
WPUB0         	 EQU  H'0000'
WPUB1         	 EQU  H'0001'
WPUB2         	 EQU  H'0002'
WPUB3         	 EQU  H'0003'
;----- CMCON3 Bits -----------------------------------------------------
VR3C0	           EQU  H'0000'
VR3C1            EQU  H'0001'
VR3C2            EQU  H'0002'
VR4C0            EQU  H'0003'
VR4C1            EQU  H'0004'
VR4C2            EQU  H'0005'
C2POL            EQU  H'0006'
C3POL            EQU  H'0007'
;----- VCON1 Bits -----------------------------------------------------
VREGHB0	         EQU  H'0000'
VREGHB1          EQU  H'0001'
VREGHB2          EQU  H'0002'
VREGHB3          EQU  H'0003'
VREGHB4          EQU  H'0004'
VREGM0           EQU  H'0005'
VREGM1           EQU  H'0006'
;----- VCON2 Bits -----------------------------------------------------
VREGLB0	         EQU  H'0000'
VREGLB1          EQU  H'0001'
VREGLB2          EQU  H'0002'
VREGLB3          EQU  H'0003'
VREGLB4          EQU  H'0004'
DAC2ON           EQU  H'0005'
DAC1ON           EQU  H'0006'
;----- PWM3CR0 Bits -----------------------------------------------------
P3BZR	           EQU  H'0000'
P3CKSRC0         EQU  H'0001'
P3CKSRC1         EQU  H'0002'
P3CKSRC2         EQU  H'0003'
P3PER0           EQU  H'0004'
P3PER1           EQU  H'0005'
P3PER2           EQU  H'0006'
P3INTS           EQU  H'0007'
;----- PWM3CR1 Bits -----------------------------------------------------
TMR3IF	         EQU  H'0000'
TMR3IE           EQU  H'0001'
TMR3ON           EQU  H'0002'
TMR3PS0          EQU  H'0003'
TMR3PS1          EQU  H'0004'
TMR3PS2          EQU  H'0005'
P3POL            EQU  H'0006'
P3EN             EQU  H'0007'
P3EB             EQU  H'0007'
;----- PWM4CR0 Bits -----------------------------------------------------
P4BZR	           EQU  H'0000'
P4CKSRC0         EQU  H'0001'
P4CKSRC1         EQU  H'0002'
P4CKSRC2         EQU  H'0003'
P4PER0           EQU  H'0004'
P4PER1           EQU  H'0005'
P4PER2           EQU  H'0006'
P4INTS           EQU  H'0007'
;----- PWM4CR1 Bits -----------------------------------------------------
TMR4IF	         EQU  H'0000'
TMR4IE           EQU  H'0001'
TMR4ON           EQU  H'0002'
TMR4PS0          EQU  H'0003'
TMR4PS1          EQU  H'0004'
TMR4PS2          EQU  H'0005'
P4POL            EQU  H'0006'
P4EN             EQU  H'0007'
P4EB             EQU  H'0007'
;----- PWM5CR0 Bits -----------------------------------------------------
P5BZR	           EQU  H'0000'
P5CKSRC0         EQU  H'0001'
P5CKSRC1         EQU  H'0002'
P5CKSRC2         EQU  H'0003'
P5PER0           EQU  H'0004'
P5PER1           EQU  H'0005'
P5PER2           EQU  H'0006'
P5INTS           EQU  H'0007'
;----- PWM5CR1 Bits -----------------------------------------------------
TMR5IF	         EQU  H'0000'
TMR5IE           EQU  H'0001'
TMR5ON           EQU  H'0002'
TMR5PS0          EQU  H'0003'
TMR5PS1          EQU  H'0004'
TMR5PS2          EQU  H'0005'
P5POL            EQU  H'0006'
P5EN             EQU  H'0007'
P5EB             EQU  H'0007'
;-----Bank3------------------
;----- DEBCR Bits -----------------------------------------------------
DEBDLY0	         EQU  H'0000'
DEBDLY1          EQU  H'0001'
DEBDLY2          EQU  H'0002'
DEBDLY3          EQU  H'0003'
DEBDLY4          EQU  H'0004'
DEBDLY5          EQU  H'0005'
TRIGSRC          EQU  H'0006'
OP0RS            EQU  H'0007'
;----- PPGCON1 Bits -----------------------------------------------------
PPGST	           EQU  H'0000'
PSTPEN           EQU  H'0002'
PRSTEN           EQU  H'0003'
PRLSEL           EQU  H'0004'
PWLTEN           EQU  H'0005'
PTRIGM           EQU  H'0007'
;----- PPRH Bits -----------------------------------------------------
PPRA8	           EQU  H'0000'
PPRB8            EQU  H'0004'
;----- PPGCON2 Bits -----------------------------------------------------
PPGDLY0	         EQU  H'0000'
PPGDLY1          EQU  H'0001'
PPGDLY2          EQU  H'0002'
PPGDLY3          EQU  H'0003'
PPGDLY4          EQU  H'0004'
PPGDLY5          EQU  H'0005'
RELDB            EQU  H'0006'
PPGON            EQU  H'0007'
;----- CMP0CR Bits -----------------------------------------------------
C0COF0	         EQU  H'0000'
C0COF1           EQU  H'0001'
C0COF2           EQU  H'0002'
C0COF3           EQU  H'0003'
C0COF4           EQU  H'0004'
C0CSEL           EQU  H'0005'
C0TM             EQU  H'0006'
C0OUT            EQU  H'0007'
;----- CMP1CR Bits -----------------------------------------------------
C1COF0	         EQU  H'0000'
C1COF1           EQU  H'0001'
C1COF2           EQU  H'0002'
C1COF3           EQU  H'0003'
C1COF4           EQU  H'0004'
C1CSEL           EQU  H'0005'
C1TM             EQU  H'0006'
C1OUT            EQU  H'0007'
;----- CMP2CR Bits -----------------------------------------------------
C2COF0	         EQU  H'0000'
C2COF1           EQU  H'0001'
C2COF2           EQU  H'0002'
C2COF3           EQU  H'0003'
C2COF4           EQU  H'0004'
C2CSEL           EQU  H'0005'
C2TM             EQU  H'0006'
C2OUT            EQU  H'0007'
;----- CMP3CR Bits -----------------------------------------------------
C3COF0	         EQU  H'0000'
C3COF1           EQU  H'0001'
C3COF2           EQU  H'0002'
C3COF3           EQU  H'0003'
C3COF4           EQU  H'0004'
C3CSEL           EQU  H'0005'
C3TM             EQU  H'0006'
C3OUT            EQU  H'0007'
;----- OP0CR0 Bits -----------------------------------------------------
OP0COF0	         EQU  H'0000'
OP0COF1          EQU  H'0001'
OP0COF2          EQU  H'0002'
OP0COF3          EQU  H'0003'
OP0COF4          EQU  H'0004'
OP0TM            EQU  H'0006'
OP0OUT           EQU  H'0007'
;----- PWM6CR0 Bits -----------------------------------------------------
P6BZR	           EQU  H'0000'
P6CKSRC0         EQU  H'0001'
P6CKSRC1         EQU  H'0002'
P6CKSRC2         EQU  H'0003'
P6PER0           EQU  H'0004'
P6PER1           EQU  H'0005'
P6PER2           EQU  H'0006'
P6INTS           EQU  H'0007'
;----- PWM6CR1 Bits -----------------------------------------------------
TMR6IF	         EQU  H'0000'
TMR6IE           EQU  H'0001'
TMR6ON           EQU  H'0002'
TMR6PS0          EQU  H'0003'
TMR6PS1          EQU  H'0004'
TMR6PS2          EQU  H'0005'
P6POL            EQU  H'0006'
P6EN             EQU  H'0007'
P6EB             EQU  H'0007'
;----- PPGCON3 Bits -----------------------------------------------------
IOEB	           EQU  H'0000'
PPGOEB           EQU  H'0001'
PPOL             EQU  H'0002'
PSYNC            EQU  H'0003'
        LIST
