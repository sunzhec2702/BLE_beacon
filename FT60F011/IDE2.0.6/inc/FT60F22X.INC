          LIST

;==========================================================================
;  MPASM FMD61F021 processor include
; 
;  (c) Copyright 1999-2016 Fremont Micro Devices Ltd., All rights reserved
;==========================================================================

        NOLIST

;==========================================================================
;==========================================================================
;
;       Verify Processor
;
;==========================================================================
;==========================================================================
;
;       Register Definitions
;
;==========================================================================
W                EQU  H'0000' 
F                EQU  H'0001'
R                EQU  H'0001'				
;----- Register Files -----------------------------------------------------
;-----Bank0------------------
INDF             EQU  H'0000'
TMR0             EQU  H'0001'
PCL              EQU  H'0002'
STATUS           EQU  H'0003'
FSR              EQU  H'0004'
PORTA            EQU  H'0005'
PORTB			 EQU  H'0006'
PORTC			 EQU  H'0007'
PORTD			 EQU  H'0008'
PCLATH           EQU  H'000A'
INTCON           EQU  H'000B'
PIR1             EQU  H'000C'
;PIR2             EQU  H'000D'
TMR1L            EQU  H'000E'
TMR1H            EQU  H'000F'
T1CON            EQU  H'0010'
TMR2             EQU  H'0011'
T2CON            EQU  H'0012'
;CCPR1L           EQU  H'0013'
;CCPR1H           EQU  H'0014'
CMP0CR0          EQU  H'0015'
CMP0CR1          EQU  H'0016'
RETCON           EQU  H'0017'
WDTCON           EQU  H'0018'
MISC0            EQU  H'0019'
LEDDRV           EQU  H'001A'
MSCKCON          EQU  H'001B'
SOSCPRL          EQU  H'001C'
SOSCPRH          EQU  H'001D'
;-----Bank1------------------
OPTION_REG       EQU  H'0081'
OPTION      	 	 EQU  H'0081'
TRISA            EQU  H'0085'
TRISB			 EQU  H'0086'
TRISC            EQU  H'0087'
TRISD            EQU  H'0088'
WPD              EQU  H'0089'
;PCLATH			 EQU  H'008A'
;INTCON			 EQU  H'008B'
PIE1             EQU  H'008C'
;PIE2             EQU  H'008D'
PCON             EQU  H'008E'
OSCCON           EQU  H'008F'
;RAMCF            EQU  H'0090'
ANSEL0            EQU  H'0091'
PR2              EQU  H'0092'
WPUD			 EQU  H'0093'
WPUB			 EQU  H'0094'
WPUA             EQU  H'0095'
IOFA              EQU  H'0096'
;IOCA             EQU  H'0096'
WPUC			 EQU  H'0097'
VRCON            EQU  H'0099'
EEDAT            EQU  H'009A'
EEDATA           EQU  H'009A'
EEADR            EQU  H'009B'
EECON1           EQU  H'009C'
EECON2           EQU  H'009D'
;-----CAP SENSE------------------
CS0CON			 EQU  H'00C0'
CS0STAT			 EQU  H'00C1'
CS0CF			 EQU  H'00C2'
CS0SCAN			 EQU  H'00C3'
;
CS0MX			 EQU  H'00C5'
;
;
;
;
CHRES0			 EQU  H'00C9'
;
;
;
IOMASK0			 EQU  H'00CD'
AUTMRH			 EQU  H'00CE'
CAPTMPH			 EQU  H'00CE'
AUTMRL			 EQU  H'00CF'
CAPTMPL			 EQU  H'00CF'
PINMON0			 EQU  H'00D0'
CS0ADJ0			 EQU  H'00D1'
CS0ADJ1			 EQU  H'00D2'
CS0ADJ2			 EQU  H'00D3'
;
;
;
CHPOL0			 EQU  H'00D7'
CS0THCF0		 EQU  H'00D8'
CS0THCF1		 EQU  H'00D9'
CS0TEST			 EQU  H'00DA'
PINMON1			 EQU  H'00DB'
CS0RSTC			 EQU  H'00DC'
;-----Bank2------------------
;VCON1            EQU  H'0108'
;VCON2            EQU  H'0109'
TMR3L            EQU  H'010C'
PR3H             EQU  H'010D'
PR3L             EQU  H'010E'
PWM3CR0          EQU  H'010F'
PWM3CR1          EQU  H'0110'
T3CKDIV          EQU  H'0111'
TMR4L            EQU  H'0112'
PR4H             EQU  H'0113'
PR4L	           EQU  H'0114'
PWM4CR0          EQU  H'0115'
PWM4CR1          EQU  H'0116'
T4CKDIV          EQU  H'0117'
TMR3H            EQU  H'0118'
TMR4H            EQU  H'0119'
I2CSTAT	         EQU  H'011A'
I2CSLA           EQU  H'011B'
I2CDAT           EQU  H'011C'
I2CMTC           EQU  H'011D'
EPWMCR0			 		 EQU  H'011E'

;-----Bank0------------------
;----- STATUS Bits -----------------------------------------------------
C                EQU  H'0000'
DC               EQU  H'0001'
HC				 EQU  H'0001'
Z                EQU  H'0002'
PF               EQU  H'0003'
NOT_PD           EQU  H'0003'
TF               EQU  H'0004'
NOT_TO           EQU  H'0004'
PAGE0			 EQU  H'0005'
RP0              EQU  H'0005'
PAGE1			 EQU  H'0006'
RP1				 EQU  H'0006'
FSR_B8			 EQU  H'0007'
;----- PORTA Bits -----------------------------------------------------
RA0              EQU  H'0000'
PA0              EQU  H'0000'
RA1              EQU  H'0001'
PA1              EQU  H'0001'
RA2              EQU  H'0002'
PA2              EQU  H'0002'
RA3              EQU  H'0003'
PA3              EQU  H'0003'
RA4              EQU  H'0004'
PA4              EQU  H'0004'
RA5              EQU  H'0005'
PA5              EQU  H'0005'
RA6              EQU  H'0006'
PA6              EQU  H'0006'
RA7              EQU  H'0007'
PA7              EQU  H'0007'
;----- PORTB Bits -----------------------------------------------------
RB0              EQU  H'0000'
PB0              EQU  H'0000'
RB1              EQU  H'0001'
PB1              EQU  H'0001'
RB2              EQU  H'0002'
PB2              EQU  H'0002'
RB3              EQU  H'0003'
PB3              EQU  H'0003'
RB4              EQU  H'0004'
PB4              EQU  H'0004'
RB5              EQU  H'0005'
PB5              EQU  H'0005'
RB6              EQU  H'0006'
PB6              EQU  H'0006'
RB7              EQU  H'0007'
PB7              EQU  H'0007'
;----- PORTC Bits -----------------------------------------------------
RC0              EQU  H'0000'
PC0              EQU  H'0000'
RC1              EQU  H'0001'
PC1              EQU  H'0001'
RC2              EQU  H'0002'
PC2              EQU  H'0002'
RC3              EQU  H'0003'
PC3              EQU  H'0003'
RC4              EQU  H'0004'
PC4              EQU  H'0004'
RC5              EQU  H'0005'
PC5              EQU  H'0005'
;----- PORTD Bits -----------------------------------------------------
RD0              EQU  H'0000'
PD0              EQU  H'0000'
RD1              EQU  H'0001'
PD1              EQU  H'0001'
;----- INTCON Bits -----------------------------------------------------
RAIF             EQU  H'0000'
PAIF             EQU  H'0000'
INTF             EQU  H'0001'
T0IF             EQU  H'0002'
TMR0IF           EQU  H'0002'
RAIE             EQU  H'0003'
PAIE             EQU  H'0003'
INTE             EQU  H'0004'
T0IE             EQU  H'0005'
TMR0IE           EQU  H'0005'
PEIE             EQU  H'0006'
GIE              EQU  H'0007'
;----- PIR1 Bits -----------------------------------------------------
TMR1IF           EQU  H'0000'
T1IF             EQU  H'0000'
TMR2IF           EQU  H'0001'
T2IF             EQU  H'0001'
OSFIF			 EQU  H'0002'
C0IF			 EQU  H'0003'
I2CIF			 EQU  H'0004'
LVDIF			 EQU  H'0005'
CKMEAIF          EQU  H'0006'
EEIF             EQU  H'0007'
;----- PIR2 Bits -----------------------------------------------------
CCP1IF           EQU  H'0000'
ADIF             EQU  H'0001'
;----- T1CON Bits -----------------------------------------------------
TMR1ON           EQU  H'0000'
TMR1CS           EQU  H'0001'
T1SYNC           EQU  H'0002'
T1OSCEN          EQU  H'0003'
T1CKPS0          EQU  H'0004'
T1CKPS1          EQU  H'0005'
TMR1GE           EQU  H'0006'
T1GINV           EQU  H'0007'
;----- T2CON Bits -----------------------------------------------------
T2CKPS0          EQU  H'0000'
T2CKPS1          EQU  H'0001'
TMR2ON           EQU  H'0002'
TOUTPS0          EQU  H'0003'
TOUTPS1          EQU  H'0004'
TOUTPS2          EQU  H'0005'
TOUTPS3          EQU  H'0006'
;----- CMP0CR0 Bits -----------------------------------------------------
C0COF0           EQU  H'0000'
C0COF1           EQU  H'0001'
C0COF2           EQU  H'0002'
C0COF3           EQU  H'0003'
C0COF4           EQU  H'0004'
C0CSEL           EQU  H'0005'
C0TM             EQU  H'0006'
C0OUT            EQU  H'0007'     
;----- CMP0CR1 Bits -----------------------------------------------------
C0ON             EQU  H'0000'
C0OE             EQU  H'0001'
C0HYSEN          EQU  H'0002'
C0DEB            EQU  H'0003'
C0POL            EQU  H'0004'
C0PSEL           EQU  H'0005'
;----- WDTCON Bits -----------------------------------------------------
SWDTEN           EQU  H'0000'
WDTPS0           EQU  H'0001'
WDTPS1           EQU  H'0002'
WDTPS2           EQU  H'0003'
WDTPS3           EQU  H'0004' 
;----- MISC0 Bits -----------------------------------------------------
INTEDG0          EQU  H'0000'
INTEDG1          EQU  H'0001'
IRMOD            EQU  H'0002'
REMDAT           EQU  H'0003'
I2CEN            EQU  H'0004'
SWRSTF           EQU  H'0007'


;----- MSCKCON Bits -----------------------------------------------------
                                    
T2CKSRC          EQU  H'0005'                                            
SLVREN           EQU  H'0004'                                            
CKMAVG           EQU  H'0002'                                            
CKCNTI           EQU  H'0001' 
;----- WPD Bits -----------------------------------------------------
                                      
WPDA4            EQU  H'0004'                                            
WPDC1            EQU  H'0003'                                                   
WPDC2            EQU  H'0002'                                            
WPDC3            EQU  H'0001'    

;----- VRCON Bits -----------------------------------------------------
VREN	         	 EQU  H'0007'                                         
VRR              EQU  H'0005'                                       
VR3              EQU  H'0003'                                                   
VR2              EQU  H'0002'                                            
VR1              EQU  H'0001'                                            
VR0              EQU  H'0000'  

;----- EECON1 Bits -----------------------------------------------------
;	         EQU  H'0007'                                            
WRLVD            EQU  H'0006'                                            
WREN3            EQU  H'0005'                                            
WREN2            EQU  H'0004'                                            
WRERR            EQU  H'0003'                                                   
WREN1              EQU  H'0002'                                            
;              EQU  H'0001'                                            
RD               EQU  H'0000'  
;----- EECON2 Bits -----------------------------------------------------
;	         EQU  H'0007'                                            
;            EQU  H'0006'                                            
;            EQU  H'0005'                                            
;            EQU  H'0004'                                            
;            EQU  H'0003'                                                   
;              EQU  H'0002'                                            
;              EQU  H'0001'                                            
WD               EQU  H'0000'   

;----- ECCPAS Bits -----------------------------------------------------
PSSBD0           EQU  H'0000'
PSSBD1           EQU  H'0001'
PSSAC0           EQU  H'0002'
PSSAC1           EQU  H'0003'
ECCPAS0          EQU  H'0004'
ECCPAS1          EQU  H'0005'
ECCPAS2          EQU  H'0006'
ECCPASE          EQU  H'0007'

;----- CMCON0 Bits -----------------------------------------------------
CM0              EQU  H'0000'
CM1              EQU  H'0001'
CM2              EQU  H'0002'
CIS              EQU  H'0003'
C1INV            EQU  H'0004'
C2INV            EQU  H'0005'
C1OUT			 EQU  H'0006'
C2OUT			 EQU  H'0007'
;----- CMCON1 Bits -----------------------------------------------------
C2SYNC           EQU  H'0000'
T1GSS            EQU  H'0001'
;----- ADCON0 Bits -----------------------------------------------------
ADON             EQU  H'0000'
GO		         EQU  H'0001'
GO_DONE          EQU  H'0001'
CHS0             EQU  H'0002'
CHS1             EQU  H'0003'
CHS2    		 EQU  H'0004'
VCFG0			 EQU  H'0005'
VCFG1			 EQU  H'0006'
ADFM			 EQU  H'0007'
;-----Bank1------------------
;----- OPTION_REG Bits -----------------------------------------------------
PS0              EQU  H'0000'
PS1              EQU  H'0001'
PS2              EQU  H'0002'
PSA              EQU  H'0003'
T0SE             EQU  H'0004'
T0CS             EQU  H'0005'
INTEDG           EQU  H'0006'
PAPU			 EQU  H'0007'
NOT_PAPU         EQU  H'0007'
NOT_RAPU         EQU  H'0007'
;----- TRISA Bits -----------------------------------------------------
TRISA0           EQU  H'0000'
TRISA1           EQU  H'0001'
TRISA2           EQU  H'0002'
TRISA3           EQU  H'0003'
TRISA4           EQU  H'0004'
TRISA5           EQU  H'0005'
TRISA6           EQU  H'0006'
TRISA7           EQU  H'0007'
;----- TRISC Bits -----------------------------------------------------
TRISC0           EQU  H'0000'
TRISC1           EQU  H'0001'
TRISC2           EQU  H'0002'
TRISC3           EQU  H'0003'
TRISC4           EQU  H'0004'
TRISC5           EQU  H'0005'
;----- WPUC Bits -----------------------------------------------------
WPUC0            EQU  H'0000'
WPUC1            EQU  H'0001'
WPUC2            EQU  H'0002'
WPUC3            EQU  H'0003'
WPUC4            EQU  H'0004'
WPUC5            EQU  H'0005'

;----- PIE1 Bits -----------------------------------------------------
T1IE             EQU  H'0000'
TMR1IE           EQU  H'0000'
T2IE             EQU  H'0001'
TMR2IE           EQU  H'0001'
OSFIE            EQU  H'0002'
C0IE             EQU  H'0003'
I2CIE            EQU  H'0004'
LVDIE            EQU  H'0005'
CKMEAIE          EQU  H'0006'
EEIE             EQU  H'0007'
;----- PIE2 Bits -----------------------------------------------------
CCP1IE           EQU  H'0000'
ADIE             EQU  H'0001'
;----- PCON Bits -----------------------------------------------------
BOR              EQU  H'0000'
NOT_BOR          EQU  H'0000'
POR              EQU  H'0001'
NOT_POR          EQU  H'0001'
LVDW             EQU  H'0002'
LVDEN            EQU  H'0003'
LVDL0            EQU  H'0004'
LVDL1            EQU  H'0005'
LVDL2            EQU  H'0006'
VREF_OE          EQU  H'0007'
;----- OSCCON Bits -----------------------------------------------------
SCS				 EQU  H'0000'
LTS              EQU  H'0001'
LFIOFR			 EQU  H'0001'
HTS              EQU  H'0002'
HFIOFR			 EQU  H'0002'
OSTS			 EQU  H'0003'
IRCF0            EQU  H'0004'
IRCF1            EQU  H'0005'
IRCF2            EQU  H'0006'
LFMOD			 EQU  H'0007'
LFOMOD			 EQU  H'0007'
;----- PWM1AUX Bits -----------------------------------------------------
P1AOE			 EQU  H'0000'
P1BOE            EQU  H'0001'
P1COE            EQU  H'0002'
P1DOE			 EQU  H'0003'
P1EOE            EQU  H'0004'
P1FOE            EQU  H'0005'
P1OS             EQU  H'0006'
AUX1EN			 EQU  H'0007'
;----- ANSEL0 Bits -----------------------------------------------------
ANSEL00			 EQU  H'0000'
ANSEL01           EQU  H'0001'
ANSEL02           EQU  H'0002'
ANSEL03			 EQU  H'0003'
ANSEL04           EQU  H'0004'
ANSEL05           EQU  H'0005'
ANSEL06           EQU  H'0006'
ANSEL07			 EQU  H'0007'
;----- WPUA Bits -----------------------------------------------------
WPUA0            EQU  H'0000'
WPUA1            EQU  H'0001'
WPUA2            EQU  H'0002'
WPUA3            EQU  H'0003'
WPUA5            EQU  H'0005'
WPUA4            EQU  H'0004'
WPUA6            EQU  H'0006'
WPUA7            EQU  H'0007'
WPU0             EQU  H'0000'
WPU1             EQU  H'0001'
WPU2             EQU  H'0002'
WPU3             EQU  H'0003'
WPU4             EQU  H'0004'
WPU5             EQU  H'0005'
WPU6             EQU  H'0006'
WPU7             EQU  H'0007'
;----- IOCA Bits -----------------------------------------------------
IOCA0            EQU  H'0000'
IOCA1            EQU  H'0001'
IOCA2            EQU  H'0002'
IOCA3            EQU  H'0003'
IOCA4            EQU  H'0004'
IOCA5            EQU  H'0005'
IOCA6            EQU  H'0006'
IOCA7            EQU  H'0007'
IOC0             EQU  H'0000'
IOC1             EQU  H'0001'
IOC2             EQU  H'0002'
IOC3             EQU  H'0003'
IOC4             EQU  H'0004'
IOC5             EQU  H'0005'
IOC6             EQU  H'0006'
IOC7             EQU  H'0007'

;----- ADCON1 Bits -----------------------------------------------------
ADCS0            EQU  H'0004'
ADCS1            EQU  H'0005'
ADCS2            EQU  H'0006'
DIVS             EQU  H'0007'
;-----Bank2------------------
;----- VCON1 Bits -----------------------------------------------------
VREGHB0	         EQU  H'0000'
VREGHB1          EQU  H'0001'
VREGHB2          EQU  H'0002'
VREGHB3          EQU  H'0003'
VREGHB4          EQU  H'0004'
VREGM0           EQU  H'0005'
VREGM1           EQU  H'0006'
;----- VCON2 Bits -----------------------------------------------------
VREGLB0	         EQU  H'0000'
VREGLB1          EQU  H'0001'
VREGLB2          EQU  H'0002'
VREGLB3          EQU  H'0003'
VREGLB4          EQU  H'0004'
;----- PWM3CR0 Bits -----------------------------------------------------
P3BZR	         EQU  H'0000'
P3CKSRC0         EQU  H'0001'
P3CKSRC1         EQU  H'0002'
P3CKSRC2         EQU  H'0003'
P3PER0           EQU  H'0004'
P3PER1           EQU  H'0005'
P3PER2           EQU  H'0006'
P3INTS           EQU  H'0007'
;----- PWM3CR1 Bits -----------------------------------------------------
TMR3IF	         EQU  H'0000'
TMR3IE           EQU  H'0001'
TMR3ON           EQU  H'0002'
TMR3PS0          EQU  H'0003'
TMR3PS1          EQU  H'0004'
TMR3PS2          EQU  H'0005'
P3POL            EQU  H'0006'
P3EB             EQU  H'0007'
P3EN             EQU  H'0007'
;----- PWM4CR0 Bits -----------------------------------------------------
P4BZR            EQU  H'0000'
P4CKSRC0         EQU  H'0001'
P4CKSRC1         EQU  H'0002'
P4CKSRC2         EQU  H'0003'
P4PER0           EQU  H'0004'
P4PER1           EQU  H'0005'
P4PER2           EQU  H'0006'
P4INTS           EQU  H'0007'
;----- PWM4CR1 Bits -----------------------------------------------------
TMR4IF	         EQU  H'0000'
TMR4IE           EQU  H'0001'
TMR4ON           EQU  H'0002'
TMR4PS0          EQU  H'0003'
TMR4PS1          EQU  H'0004'
TMR4PS2          EQU  H'0005'
P4POL            EQU  H'0006'
P4EB             EQU  H'0007'
P4EN             EQU  H'0007'

;----- PWM5CR0 Bits -----------------------------------------------------
P5BZR	         EQU  H'0000'
P5CKSRC0         EQU  H'0001'
P5CKSRC1         EQU  H'0002'
P5CKSRC2         EQU  H'0003'
P5PER0           EQU  H'0004'
P5PER1           EQU  H'0005'
P5PER2           EQU  H'0006'
P5INTS           EQU  H'0007'
;----- PWM5CR1 Bits -----------------------------------------------------
TMR5IF	         EQU  H'0000'
TMR5IE           EQU  H'0001'
TMR5ON           EQU  H'0002'
TMR5PS0          EQU  H'0003'
TMR5PS1          EQU  H'0004'
TMR5PS2          EQU  H'0005'
P5POL            EQU  H'0006'
P5EB             EQU  H'0007'
P5EN             EQU  H'0007'

;----- I2CSTAT Bits -----------------------------------------------------
I2CDF	         EQU  H'0007'
I2CMATF          EQU  H'0006'
;           EQU  H'0005'
I2CRW            EQU  H'0004'
I2CRXACK         EQU  H'0003'
I2CTXACK         EQU  H'0002'
I2CTXM           EQU  H'0001'
I2CBUSY          EQU  H'0000'
;----- I2CSLA Bits -----------------------------------------------------
;	         EQU  H'0007'
;          EQU  H'0006'
;           EQU  H'0005'
;            EQU  H'0004'
;         EQU  H'0003'
;         EQU  H'0002'
;           EQU  H'0001'
DMY0          EQU  H'0000'
;----- I2CMTC Bits -----------------------------------------------------
I2CMEN	         EQU  H'0007'
I2CTOV           EQU  H'0006'
;           EQU  H'0005'
;            EQU  H'0004'
;         EQU  H'0003'
;         EQU  H'0002'
;           EQU  H'0001'
;          EQU  H'0000'
;----- EPWMCR0 Bits -----------------------------------------------------
;	         EQU  H'0007'
;          EQU  H'0006'
P4FCKS           EQU  H'0005'
P3FCKS           EQU  H'0004'
;         EQU  H'0003'
;         EQU  H'0002'
P4IOE            EQU  H'0001'
P3IOE            EQU  H'0000'
;----- CS0CON Bits -----------------------------------------------------
CS0EN	         EQU  H'0007'
CS0STR           EQU  H'0006'
CHBUFE           EQU  H'0005'
;          EQU  H'0004'
;          EQU  H'0003'
EOSIE            EQU  H'0002'
CMPIE            EQU  H'0001'
SCIE             EQU  H'0000'
;----- CS0STAT Bits -----------------------------------------------------
CS0CMPF	         EQU  H'0007'
EOSIF            EQU  H'0006'
CS0INTF          EQU  H'0005'
;          EQU  H'0004'
;          EQU  H'0003'
;            EQU  H'0002'
CS0BUSY          EQU  H'0001'
MULTRES          EQU  H'0000'
;----- CS0CF Bits -----------------------------------------------------
CS0CMPE	         EQU  H'0007'
CS0MCEN          EQU  H'0006'
CS0CR1           EQU  H'0005'
CS0CR0           EQU  H'0004'
CS0ACU2          EQU  H'0003'
CS0ACU1          EQU  H'0002'
CS0ACU0          EQU  H'0001'
MULTPOL          EQU  H'0000'
;----- CS0SCAN Bits -----------------------------------------------------
AUSCAN	         EQU  H'0007'
MASCAN           EQU  H'0006'
;           EQU  H'0005'
;           EQU  H'0004'
;          EQU  H'0003'
;          EQU  H'0002'
;          EQU  H'0001'
;          EQU  H'0000'
;----- CS0MX Bits -----------------------------------------------------
;	         EQU  H'0007'
;           EQU  H'0006'
;           EQU  H'0005'
;           EQU  H'0004'
;          EQU  H'0003'
CS0MX2          EQU  H'0002'
CS0MX1          EQU  H'0001'
CS0MX0          EQU  H'0000'
;----- PINMON0 Bits -----------------------------------------------------
CS0PEVT	         EQU  H'0007'
;           EQU  H'0006'
PMONEN13         EQU  H'0005'
PMONEN12         EQU  H'0004'
PMONEN11         EQU  H'0003'
PMONEN10         EQU  H'0002'
PMONEN9          EQU  H'0001'
PMONEN8          EQU  H'0000'
;----- CS0ADJ0 Bits -----------------------------------------------------
DRMX1	         EQU  H'0007'
DRMX0            EQU  H'0006'
CGMX2            EQU  H'0005'
CGMX1            EQU  H'0004'
CGMX0            EQU  H'0003'
DTMX2            EQU  H'0002'
DTMX1            EQU  H'0001'
DTMX0            EQU  H'0000'
;----- CS0ADJ1 Bits -----------------------------------------------------
DRMULT1	         EQU  H'0007'
DRMULT0          EQU  H'0006'
CGMULT2          EQU  H'0005'
CGMULT1          EQU  H'0004'
CGMULT0          EQU  H'0003'
DTMULT2          EQU  H'0002'
DTMULT1          EQU  H'0001'
DTMULT0          EQU  H'0000'
;----- CS0ADJ2 Bits -----------------------------------------------------
CS0IA2	         EQU  H'0007'
CS0IA1           EQU  H'0006'
CS0IA0           EQU  H'0005'
CS0RP1           EQU  H'0004'
CS0RP0           EQU  H'0003'
CS0LP2           EQU  H'0002'
CS0LP1           EQU  H'0001'
CS0LP0           EQU  H'0000'
;----- CS0THCF0 Bits -----------------------------------------------------
UPDEN	         EQU  H'0007'
THUMOD           EQU  H'0006'
UFORCE           EQU  H'0005'
ACCRST           EQU  H'0004'
;           EQU  H'0003'
;           EQU  H'0002'
;           EQU  H'0001'
;           EQU  H'0000'
;----- CS0THCF1 Bits -----------------------------------------------------
THGAP2	         EQU  H'0007'
THGAP1           EQU  H'0006'
THGAP0           EQU  H'0005'
;           EQU  H'0004'
;           EQU  H'0003'
;           EQU  H'0002'
;           EQU  H'0001'
;           EQU  H'0000'
;----- C0TEST Bits -----------------------------------------------------
TESTM1	         EQU  H'0007'                                            
TESTM0           EQU  H'0006'                                            
CSST4            EQU  H'0005'                                            
CSST3            EQU  H'0004'                                            
CSST2            EQU  H'0003'                                                   
CSST1            EQU  H'0002'                                            
CSST0            EQU  H'0001'                                            
PORDIR           EQU  H'0000'  

 LIST                                           